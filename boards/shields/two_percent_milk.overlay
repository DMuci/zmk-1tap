/ {
    behaviors {
        tap_dance_click_escape: tap_dance_click_escape {
            compatible = "zmk,behavior-tap-dance";
            #binding-cells = <2>;
            bindings = <&kp ESC>, <&mkp LCLK>;
            tapping-term-ms = <200>;
        };
    };
};
